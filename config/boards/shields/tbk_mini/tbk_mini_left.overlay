/*
 * Copyright (c) 2020 Pete Johanson
 *
 * SPDX-License-Identifier: MIT
 */

#include "tbk_mini.dtsi"

&kscan0 {
	// col-gpios
	// 	= <&gpio0 19 (GPIO_ACTIVE_HIGH | GPIO_PULL_DOWN)>  // B4
	// 	, <&gpio0 20 (GPIO_ACTIVE_HIGH | GPIO_PULL_DOWN)>  // E6
	// 	, <&gpio0 10 (GPIO_ACTIVE_HIGH | GPIO_PULL_DOWN)>  // C6
	// 	, <&gpio1 6 (GPIO_ACTIVE_HIGH | GPIO_PULL_DOWN)>  // B1
	// 	, <&gpio0 7  (GPIO_ACTIVE_HIGH | GPIO_PULL_DOWN)>  // B3
	// 	, <&gpio0 8 (GPIO_ACTIVE_HIGH | GPIO_PULL_DOWN)>  // B2
	// 	;
	col-gpios
		= <&gpio0 19 (GPIO_ACTIVE_HIGH | GPIO_PULL_DOWN)>
		, <&gpio0 20 (GPIO_ACTIVE_HIGH | GPIO_PULL_DOWN)>
		, <&gpio0 10 (GPIO_ACTIVE_HIGH | GPIO_PULL_DOWN)>
		, <&gpio0 6 (GPIO_ACTIVE_HIGH | GPIO_PULL_DOWN)>
		, <&gpio0 7  (GPIO_ACTIVE_HIGH | GPIO_PULL_DOWN)>
		, <&gpio0 8 (GPIO_ACTIVE_HIGH | GPIO_PULL_DOWN)>
		;
};
